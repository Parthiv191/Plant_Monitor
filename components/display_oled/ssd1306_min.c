#include "ssd1306_min.h"
#include <stdarg.h>
#include <stdio.h>
#include <string.h>
#include "esp_log.h"

static const char *TAG = "SSD1306_MIN";

// 5x7 font (ASCII 32..127); each char is 5 columns, LSB top.
// To keep this concise, this is a compact, common 5x7 set.
static const uint8_t font5x7[96][5] = {
    {0x00,0x00,0x00,0x00,0x00}, // ' '
    {0x00,0x00,0x5F,0x00,0x00}, // '!'
    {0x00,0x07,0x00,0x07,0x00}, // '"'
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    {0x02,0x01,0x02,0x04,0x02}, // '~'
};

static uint8_t page_buffer[SSD1306_WIDTH * (SSD1306_HEIGHT/8)];
static uint8_t cursor_x = 0;
static uint8_t cursor_page = 0;

static void i2c_write(uint8_t addr, const uint8_t *data, size_t len, bool is_cmd)
{
    i2c_cmd_handle_t cmd = i2c_cmd_link_create();
    i2c_master_start(cmd);
    i2c_master_write_byte(cmd, (addr << 1) | I2C_MASTER_WRITE, true);
    uint8_t ctrl = is_cmd ? 0x00 : 0x40;
    i2c_master_write_byte(cmd, ctrl, true);
    i2c_master_write(cmd, (uint8_t*)data, len, true);
    i2c_master_stop(cmd);
    i2c_master_cmd_begin(OLED_I2C_PORT, cmd, pdMS_TO_TICKS(100));
    i2c_cmd_link_delete(cmd);
}

void ssd1306_cmd(uint8_t c){ i2c_write(SSD1306_ADDR, &c, 1, true); }
void ssd1306_cmd2(uint8_t c1, uint8_t c2){ uint8_t d[2]={c1,c2}; i2c_write(SSD1306_ADDR,d,2,true); }
void ssd1306_data(const uint8_t *d, size_t n){ i2c_write(SSD1306_ADDR, d, n, false); }

void ssd1306_init(void)
{
    i2c_config_t cfg = {
        .mode = I2C_MODE_MASTER,
        .sda_io_num = OLED_I2C_SDA,
        .scl_io_num = OLED_I2C_SCL,
        .sda_pullup_en = GPIO_PULLUP_ENABLE,
        .scl_pullup_en = GPIO_PULLUP_ENABLE,
        .master.clk_speed = OLED_I2C_FREQ
    };
    i2c_param_config(OLED_I2C_PORT, &cfg);
    i2c_driver_install(OLED_I2C_PORT, I2C_MODE_MASTER, 0, 0, 0);

    vTaskDelay(pdMS_TO_TICKS(100));

    // Init sequence (page addressing mode)
    ssd1306_cmd(0xAE); // display off
    ssd1306_cmd2(0xD5, 0x80); // clock div
    ssd1306_cmd2(0xA8, SSD1306_HEIGHT-1); // multiplex
    ssd1306_cmd2(0xD3, 0x00); // display offset
    ssd1306_cmd(0x40 | 0x00); // start line
    ssd1306_cmd2(0x8D, 0x14); // charge pump
    ssd1306_cmd2(0x20, 0x02); // memory mode: page addressing
    ssd1306_cmd(0xA1); // seg remap
    ssd1306_cmd(0xC8); // com scan dec
    ssd1306_cmd2(0xDA, 0x12); // compins
    ssd1306_cmd2(0x81, 0x7F); // contrast
    ssd1306_cmd(0xA4); // display resume
    ssd1306_cmd(0xA6); // normal display
    ssd1306_cmd2(0xD9, 0xF1); // precharge
    ssd1306_cmd2(0xDB, 0x40); // vcom detect
    ssd1306_cmd(0x2E); // deactivate scroll
    ssd1306_cmd(0xAF); // display on

    memset(page_buffer, 0x00, sizeof(page_buffer));
    cursor_x = 0; cursor_page = 0;
    ssd1306_refresh();
    ESP_LOGI(TAG, "SSD1306 init OK");
}

void ssd1306_set_cursor(uint8_t x, uint8_t page)
{
    if (x >= SSD1306_WIDTH) x = 0;
    if (page >= (SSD1306_HEIGHT/8)) page = 0;
    cursor_x = x;
    cursor_page = page;
}

static void put_char(char c)
{
    if (c < 32 || c > 127) c = '?';
    const uint8_t *glyph = font5x7[c-32];

    uint16_t offset = cursor_page * SSD1306_WIDTH + cursor_x;
    if (offset + 6 >= sizeof(page_buffer)) return;

    // 5 columns of glyph, then 1 blank column as spacing
    for (int i = 0; i < 5; ++i) page_buffer[offset + i] = glyph[i];
    page_buffer[offset + 5] = 0x00;

    cursor_x += 6;
    if (cursor_x > SSD1306_WIDTH - 6) { cursor_x = 0; cursor_page++; }
}

void ssd1306_print(const char *s)
{
    while (*s) {
        if (*s == '\n') {
            cursor_x = 0;
            cursor_page++;
        } else {
            put_char(*s);
        }
        s++;
        if (cursor_page >= (SSD1306_HEIGHT/8)) break;
    }
}

void ssd1306_printf(const char *fmt, ...)
{
    char buf[64];
    va_list ap; va_start(ap, fmt);
    vsnprintf(buf, sizeof(buf), fmt, ap);
    va_end(ap);
    ssd1306_print(buf);
}

void ssd1306_clear(bool refresh)
{
    memset(page_buffer, 0x00, sizeof(page_buffer));
    cursor_x = 0; cursor_page = 0;
    if (refresh) ssd1306_refresh();
}

void ssd1306_refresh(void)
{
    for (uint8_t page = 0; page < (SSD1306_HEIGHT/8); ++page) {
        ssd1306_cmd(0xB0 | page);          // set page address
        ssd1306_cmd(0x00);                 // low col
        ssd1306_cmd(0x10);                 // high col
        ssd1306_data(&page_buffer[page * SSD1306_WIDTH], SSD1306_WIDTH);
    }
}